;MCD1实战二：《单键触发8位二进制累加计数器》
;程序文件名为"MCD-LED2.ASM"
;PIC单片机学习网   http://www.pic16.com
;该程序的目的是让大家熟悉输入、输出端口的使用
;该程序的功能是把演示板当做一个按键计数器。刚刚接通电源时，8只发光二极管都不亮。
;表示计数器初值为0，当按下开关S3（RB0）时，计数器的值加1，发光二极管D3点亮，表示值1，然后松开
;按钮；再次按下开关S3（RB0）时，计数器的值又加1，发光二极管D4点亮，表示值2，依次类推，反复循环。
;程序清单：
;*************************************************
status    equ     3h   ;定义状态寄存器地址
portb     equ     6h   ;定义端口B的数据寄存器地址
trisb     equ     86h  ;定义端口B的方向控制寄存器地址
portc     equ     7h   ;定义端口C的数据寄存器地址
trisc     equ     87h  ;定义端口C的方向控制寄存器地址
data1     equ     20h  ;定义一个廷时变量寄存器
data2     equ     21h  ;定义另一个廷时变量寄存器
n1        equ     d'13'  ;定义一个外层循环廷时常数
n2        equ     0ffh   ;定义一个内层廷时常数
rp0       equ     5h     ;定义状态寄存器的页选位RP0
;*************************************************
          org 000h       ;定义程序存放区域的起始地址
          nop            ;放置一条ICD必须的空操作指令
          bsf status,rp0  ;设置文件寄存器体1
          movlw 00h       ;将端口C的方向控制码00H先送W
          movwf trisc     ;再转到方向寄存器，将其设置为输出
          movlw 0ffh      ;同理，将端口B设置为输入
          movwf trisb     ;
          bcf status,rp0  ;恢复到文件寄存器体0
          movlw 00h       ;送计器初值00H到RC口显示
          movwf portc     ;
check     btfsc portb,0   ;测试S3按下否？是！跳过下条指令
          goto check      ;否！则循环检测
          call delay      ;调用廷时子程序，消除按钮抖动的影响
          btfsc portb,0   ;再次测试S3按下否？是！跳过下条指令
          goto check      ;否！则循不检测
          incf portc,1    ;端口C的数据寄存器加1，并送LED显示
check1    btfss portb,0   ;测试S3断开否？是！跳过下条指令
          goto check1     ;否！则循不检测
          call delay      ;调用廷时子程序，消除按钮抖动的影响
          btfss portb,0   ;再次测试S3断开否？是！跳过下条指令
          goto check1     ;否！则循不检测
          goto check      ;返回
;*************10MS廷时子程序************************
delay                     ;子程序名，也是子程序入口地址
          movlw n1        ;将外层循环参数值送到DATA1
          movwf data1     ;
lp0       movlw n2        ;将内层循环参数值送到DATA2
          movwf data2     ;
lp1       decfsz data2,1  ;变量DATA2内容递减，若为0则跳跃
          goto lp1        ;跳转到LP1
          decfsz data1,1  ;变量DATA1内容递减，若为0则跳跃
          goto lp0        ;跳转到LP0
          return          ;返回主程序
          end             ;源程序结束
;***************************************************
;    进入该实战演练的工序流程如下:
;    1.软硬件的安装:按照本说明书前面讲的”MPLAB-ICD的安装和使用”一节内介绍的方法操作即可.
;    2.创建源文件和编辑源文件;在此介绍一种不同于前面讲的创建源文件的方法,用Windows附件中的”记事本”
;   这个为大家所熟知和好用的文件编辑器,并且可以方便的加入中文注释.不过有两点需要注意,一是注释前面的
;   分号”;”必须用西文半角输入;二是必须用”.asm”扩展名存储到事先建立的一个专用子目录下.
;    3.打开MPLAB集成开发环境:首先在WINDOWS环境下,选用开始>程序>Microchip MPLAB>MPLAB命令,启动MPLAB
;   并进入MPLAB的桌面.
;    4.创建项目:选用菜单File>New或Project>New Project,在事先建立的一个专用子目录下创建一个新项目,将
;   用记事本创建的源文件加入到该项目中.
;    5.建立项目中的目标文件:选择菜单Project >Build All(项目>建立所有文件),MPLAB将自动调用MPASM将项目
;   文件管理下的源文件(.asm)汇编成十六进制的目标文件(.hex).
;    6.ICD参数设置:通过菜单命令Project>Edit Project或者Option>Development Mode,将开发模式设置为
;   ”MPLAB ICD Debugger”,点击OK按钮,打开ICD的工作窗口,在调试阶段,可以按照说明书图2-10设置各项,但需注意
;   OSCILLATOR应设置为XT方式,尤其需要说明的是，选中“Enable Debug Mode”（使能调试模式）选项，在向目
;   标单片机烧写机器码程序时，会将调试临控程序同时写入单片机的指定程序存储器区域，然后才允许用ICD方式调试。
;    7.电路设置:将演示板的S1全部拔到ON，S4全部拔到OFF，S13的第1拔到ON、第5、第6、第7全部拔到OFF ，LCD不要插在演示板上，
;   以使端口C只与8只发光二极管接通;将用于选择频率的插针跳线插到”XT OSC”位置上.
;    8.向目标单片机烧写目标程序:用户在点击功能按钮”Program”向目标单片机烧写机器码程序时,会等待一段时间，
;   并且在条状的状态信息栏中，出现提示信息。有一点需要引起注意，就是PIC16F87X单片机的FLASH程序存储器的擦写
;   周期是有限的，大约为1000次，应尽量节省它的使用寿命。
;    9.运行和调试用户程序和用户电路:在各项参数设置好后,将ICD的工作窗口最小化,利用前面讲的”运行及调试”中介
;   绍的几种方法进行调试.当用自动单步方式调试时,建议临时禁止廷时子程序发挥作用,具体的方法是,可在CALL DELAY指
;   令前添加一个分号,并且重新汇编一次.为了学习目的,在调试过程中可以人为地加入一些软件漏洞(BUG)或硬件故障,来模
;   仿单片机端口引脚的片内或片外故障.
;    10.定型烧写目标单片机;经过多次重复上述步骤的反复修改和调试,使得程序和电路在联机状态完全正常,这时可以进行
;   定型烧写,即将ICD窗口中的”Enable Debug Mode”(使能调试模式)选项消除,不再将调试临控程序写入单片机中.
;    11.独立运行验收:上一步中的烧写过程完成后,即可将ICD模块和ICD仿真头(或演示板)之间的6芯电缆断开,让单片机在
;   演示板独立运行,观察实际效果.
;
;
