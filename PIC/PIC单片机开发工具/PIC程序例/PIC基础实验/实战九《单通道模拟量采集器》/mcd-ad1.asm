;实战七《单通道模拟量采集器》
;本实战的目的是让大家熟悉ADC模块的功能以及AD转换的方法
;项目实现的功能：从芯片RA0输入一个可以随时变化的模拟量（通过调节DEMO板VR1实现）
;则单片机就能够及时地把该模拟量进行模/数转换，并用LED显示出来，我们可以看到转换结果
;会随模拟量的变化而变化，从而以让我们了解片内ADC模块的工作情况。
;本例的软件设计思路：利用单片机片内硬件资源TMR0和预分频器，为ADC提供定时启动信号。但是
;没有利用其中断功能，而是采用了软件查询方式，转换结果采用了左对齐方式。忽略了最低2位，将
;10位AD当做8位来用了，A/D转换的时钟源选用了系统周期的8倍，本例对于ADC的电压基准要求不高
;我们就选用了电源电压VDD和VSS作为基准电压，对于A/D转换过程是否完成也没有利用ADC模块的中断功能
;而是以软件方式查询其中断标志位ADIF。本例中选用的模拟通道为AN0。
;同时，本例中使用了一些大家之前都未接触的宏指令。
;PIC单片机学习网  陈学乾  http://www.pic16.com
;程序文件名“MCD-AD1.ASM"
;程序清单如下:
;************************************
   LIST   P=16F877                       ;列表伪指令
   INCLUDE "P16F877.INC"                 ;把包含文件含入源程序
   ORG    0000H
   NOP                                   ;放置一条ICD必段的空操作指令
START
   BANKSEL PORTC                          ;选择同PORTC寄存器相同的体
   CLRF    PORTC                          ;清PORTC
   MOVLW  B'010000001'                    ;选择:时钟时钟源为FOSC/8,允许ADC工作
   MOVWF  ADCON0                          ;通道AN0,暂时不启动转换过程

   BANKSEL OPTION_REG                     ;选择寄存器OPTION_REG的体为当前体
   MOVLW  B'10000111'                     ;设定:RB口不用上拉,分频器配给TMR0
   MOVWF   OPTION_REG                     ;分频比设为1:256
   CLRF    TRISC                          ;PORTC所有管脚设为输出(接LED)
   MOVLW   B'00001110'                    ;转换结果左对齐,只选1个A/D通道RA0/AN0
   MOVWF   ADCON1                         ;选择VDD和VSS作参考源
   BANKSEL PORTC                          ;选中同寄存器PORTC的体为当前体
;---------------------------------
MAIN
   BTFSS   INTCON,T0IF                    ;等待和循环检测TMR0溢出中断标志位
   GOTO    MAIN                           ;如果没有发生TMR0溢出中断则返回循环检测
   BCF     INTCON,T0IF                    ;如果发生了TMR0溢出中断,则清除标志位T0IF
   BSF     ADCON0,GO                      ;开启A/D转换过程
WAIT
   BTFSS   PIR1,ADIF                      ;等待A/D转换过程结束,检测ADC中断标志位
   GOTO    WAIT                           ;如果没有转换结束,则返回循环检测
   MOVF    ADRESH,W                       ;如果转换完毕,则把A/D结果读到W
   MOVWF   PORTC                          ;经过W送C口LED显示
   GOTO    MAIN                           ;循环进行A/D转换
;---------------------------------
   END                                    ;源程序结束
;*****************************************************
;    进入该实战演练的工序流程如下:
;    1.创建源文件和编辑源文件;在此介绍一种不同于前面讲的创建源文件的方法,用Windows附件中的”记事本”
;   这个为大家所熟知和好用的文件编辑器,并且可以方便的加入中文注释.不过有两点需要注意,一是注释前面的
;   分号”;”必须用西文半角输入;二是必须用”.asm”扩展名存储到事先建立的一个专用子目录下.
;    2.打开MPLAB集成开发环境:首先在WINDOWS环境下,选用开始>程序>Microchip MPLAB>MPLAB命令,启动MPLAB
;   并进入MPLAB的桌面.
;    3.创建项目:选用菜单File>New或Project>New Project,在事先建立的一个专用子目录下创建一个新项目,将
;   用记事本创建的源文件加入到该项目中.
;    4.建立项目中的目标文件:选择菜单Project >Build All(项目>建立所有文件),MPLAB将自动调用MPASM将项目
;   文件管理下的源文件(.asm)汇编成十六进制的目标文件(.hex).
;    5.ICD参数设置:通过菜单命令Project>Edit Project或者Option>Development Mode,将开发模式设置为
;   ”MPLAB ICD Debugger”,点击OK按钮,打开ICD的工作窗口,在调试阶段,可以按照说明书图2-10设置各项,但需注意
;   OSCILLATOR应设置为XT方式,尤其需要说明的是，选中“Enable Debug Mode”（使能调试模式）选项，在向目
;   标单片机烧写机器码程序时，会将调试临控程序同时写入单片机的指定程序存储器区域，然后才允许用ICD方式调试。
;    6.电路设置:将演示板的S1全部拔到ON，S13的第二脚拔到ON，S13的其它脚全部拔到OFF，S4,S5全部拔到OFF ，LCD不用插在演示板上，
;   将用于选择频率的插针跳线插到”XT OSC”位置上。
;    7.向目标单片机烧写目标程序:用户在点击功能按钮”Program”向目标单片机烧写机器码程序时,会等待一段时间，
;   并且在条状的状态信息栏中，出现提示信息。有一点需要引起注意，就是PIC16F87X单片机的FLASH程序存储器的擦写
;   周期是有限的，大约为1000次，应尽量节省它的使用寿命。
;    8.运行和调试用户程序和用户电路:在各项参数设置好后,将ICD的工作窗口最小化,利用前面讲的”运行及调试”中介
;   绍的几种方法进行调试.当用自动单步方式调试时,建议临时禁止廷时子程序发挥作用,具体的方法是,可在CALL DELAY指
;   令前添加一个分号,并且重新汇编一次.为了学习目的,在调试过程中可以人为地加入一些软件漏洞(BUG)或硬件故障,来模
;   仿单片机端口引脚的片内或片外故障.
;    9.定型烧写目标单片机;经过多次重复上述步骤的反复修改和调试,使得程序和电路在联机状态完全正常,这时可以进行
;   定型烧写,即将ICD窗口中的”Enable Debug Mode”(使能调试模式)选项消除,不再将调试临控程序写入单片机中.
;    10.独立运行验收:上一步中的烧写过程完成后,即可将ICD模块和ICD仿真头(或演示板)之间的6芯电缆断开,让单片机在
;   演示板独立运行,观察实际效果.


